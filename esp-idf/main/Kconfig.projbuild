## esp-idf/main/Kconfig.projbuild
```kconfig
menu "ESP32-P4 Smart Speaker Configuration"

    config WIFI_SSID
        string "WiFi SSID"
        default "YourWiFiSSID"
        help
            WiFi network name to connect to.

    config WIFI_PASSWORD
        string "WiFi Password"
        default "YourWiFiPassword"
        help
            WiFi password.

    config HA_HOST
        string "Home Assistant Host"
        default "homeassistant.local"
        help
            Home Assistant hostname or IP address.

    config HA_PORT
        int "Home Assistant Port"
        default 8123
        help
            Home Assistant API port.

    config HA_TOKEN
        string "Home Assistant Long-Lived Access Token"
        default "YOUR_LONG_LIVED_ACCESS_TOKEN"
        help
            Home Assistant long-lived access token for API authentication.
            Generate from: Profile -> Long-Lived Access Tokens

endmenu
```

## esp-idf/sdkconfig.defaults
```kconfig
# ESP32-P4 Smart Speaker SDK Configuration Defaults

# Target: ESP32-P4
CONFIG_IDF_TARGET="esp32p4"

# CPU Frequency
CONFIG_ESP_DEFAULT_CPU_FREQ_MHZ_400=y
CONFIG_ESP_DEFAULT_CPU_FREQ_MHZ=400

# PSRAM Configuration
CONFIG_SPIRAM=y
CONFIG_SPIRAM_MODE_OCT=y
CONFIG_SPIRAM_SPEED_80M=y
CONFIG_SPIRAM_BOOT_INIT=y

# Flash Configuration
CONFIG_ESPTOOLPY_FLASHSIZE_16MB=y
CONFIG_ESPTOOLPY_FLASHMODE_DIO=y

# USB Host Configuration
CONFIG_USB_OTG_SUPPORTED=y
CONFIG_USB_HOST_ENABLE=y
CONFIG_USB_HOST_CONTROL_TRANSFER_MAX_SIZE=1024
CONFIG_USB_HOST_HW_BUFFER_BIAS_BALANCED=y

# FreeRTOS
CONFIG_FREERTOS_HZ=1000
CONFIG_FREERTOS_UNICORE=n

# Logging
CONFIG_LOG_DEFAULT_LEVEL_INFO=y
CONFIG_LOG_DEFAULT_LEVEL=3

# WiFi (via ESP32-C6)
CONFIG_ESP_WIFI_STATIC_RX_BUFFER_NUM=10
CONFIG_ESP_WIFI_DYNAMIC_RX_BUFFER_NUM=32
CONFIG_ESP_WIFI_TX_BUFFER_TYPE=1
CONFIG_ESP_WIFI_DYNAMIC_TX_BUFFER_NUM=32

# HTTP Client
CONFIG_ESP_HTTP_CLIENT_ENABLE_HTTPS=y
CONFIG_ESP_HTTP_CLIENT_ENABLE_BASIC_AUTH=n

# TLS
CONFIG_MBEDTLS_CERTIFICATE_BUNDLE=y
CONFIG_MBEDTLS_CERTIFICATE_BUNDLE_DEFAULT_FULL=y

# I2S
CONFIG_I2S_ISR_IRAM_SAFE=y

# I2C
CONFIG_I2C_ISR_IRAM_SAFE=y

# Task Watchdog
CONFIG_ESP_TASK_WDT_TIMEOUT_S=10

# UART (for SEN0395 mmWave Radar)
CONFIG_UART_ISR_IN_IRAM=y

# Sensor Hub Task Stack Sizes
CONFIG_ESP_MAIN_TASK_STACK_SIZE=4096
```

## main/Kconfig.projbuild
```kconfig
menu "Omni-P4 Configuration"

    config OMNI_P4_BOARD_NAME
        string "Board Name"
        default "ESP32-P4-Function-EV-Board"
        help
            Name of the target board for logging and identification.

    menu "Audio Configuration"
        config OMNI_P4_AUDIO_ENABLED
            bool "Enable Audio Pipeline"
            default y
            help
                Enable the dual I2S audio pipeline (ES9039Q2M DAC + ReSpeaker).

        menu "I2S0 - DAC Output (ES9039Q2M)"
            depends on OMNI_P4_AUDIO_ENABLED

            config I2S0_BCK_GPIO
                int "I2S0 BCK (Bit Clock) GPIO"
                default 12
                range 0 54

            config I2S0_WS_GPIO
                int "I2S0 WS (Word Select/LRCK) GPIO"
                default 13
                range 0 54

            config I2S0_DOUT_GPIO
                int "I2S0 Data Out GPIO"
                default 14
                range 0 54

            config I2S0_MCLK_GPIO
                int "I2S0 MCLK GPIO"
                default 11
                range 0 54

            config I2S0_SAMPLE_RATE
                int "I2S0 Sample Rate (Hz)"
                default 48000
                range 8000 192000

            config I2S0_BIT_WIDTH
                int "I2S0 Bit Width"
                default 32
                range 16 32
        endmenu

        menu "I2S1 - Mic Input (ReSpeaker XVF3800)"
            depends on OMNI_P4_AUDIO_ENABLED

            config I2S1_BCK_GPIO
                int "I2S1 BCK (Bit Clock) GPIO"
                default 15
                range 0 54

            config I2S1_WS_GPIO
                int "I2S1 WS (Word Select/LRCK) GPIO"
                default 16
                range 0 54

            config I2S1_DIN_GPIO
                int "I2S1 Data In GPIO"
                default 17
                range 0 54

            config I2S1_MCLK_GPIO
                int "I2S1 MCLK GPIO"
                default 18
                range 0 54

            config I2S1_SAMPLE_RATE
                int "I2S1 Sample Rate (Hz)"
                default 16000
                range 8000 48000
        endmenu

        config DAC_I2C_ADDR
            hex "ES9039Q2M I2C Address"
            default 0x48
            depends on OMNI_P4_AUDIO_ENABLED
    endmenu

    menu "Display Configuration"
        config OMNI_P4_DISPLAY_ENABLED
            bool "Enable MIPI-DSI Display"
            default y
            help
                Enable the 7-inch MIPI-DSI LCD with LVGL.

        config DISPLAY_H_RES
            int "Horizontal Resolution"
            default 1024
            depends on OMNI_P4_DISPLAY_ENABLED

        config DISPLAY_V_RES
            int "Vertical Resolution"
            default 600
            depends on OMNI_P4_DISPLAY_ENABLED

        config DISPLAY_REFRESH_HZ
            int "Refresh Rate (Hz)"
            default 60
            depends on OMNI_P4_DISPLAY_ENABLED

        config DISPLAY_BACKLIGHT_GPIO
            int "Backlight Control GPIO"
            default 26
            range -1 54
            depends on OMNI_P4_DISPLAY_ENABLED
            help
                GPIO for LCD backlight PWM control. Set -1 to disable.

        config DISPLAY_TOUCH_I2C_ADDR
            hex "Touch Panel I2C Address"
            default 0x5D
            depends on OMNI_P4_DISPLAY_ENABLED
    endmenu

    menu "LED Ring Configuration"
        config OMNI_P4_LED_ENABLED
            bool "Enable WS2812B LED Ring"
            default y
            help
                Enable the Phantom LED ring (Nest Mini style).

        config LED_STRIP_GPIO
            int "LED Strip Data GPIO"
            default 21
            range 0 54
            depends on OMNI_P4_LED_ENABLED

        config LED_STRIP_COUNT
            int "Number of LEDs"
            default 12
            range 1 60
            depends on OMNI_P4_LED_ENABLED

        config LED_STRIP_RMT_CHANNEL
            int "RMT Channel"
            default 0
            range 0 7
            depends on OMNI_P4_LED_ENABLED
    endmenu

    menu "Sensor Hub Configuration"
        config OMNI_P4_SENSORS_ENABLED
            bool "Enable Sensor Hub"
            default y
            help
                Enable the multi-sensor hub (I2C + UART sensors).

        menu "I2C Bus Configuration"
            depends on OMNI_P4_SENSORS_ENABLED

            config SENSOR_I2C_PORT
                int "I2C Port Number"
                default 0
                range 0 1

            config SENSOR_I2C_SDA_GPIO
                int "I2C SDA GPIO"
                default 7
                range 0 54

            config SENSOR_I2C_SCL_GPIO
                int "I2C SCL GPIO"
                default 8
                range 0 54

            config SENSOR_I2C_FREQ_HZ
                int "I2C Frequency (Hz)"
                default 100000
                range 100000 400000
        endmenu

        menu "I2C Sensor Addresses"
            depends on OMNI_P4_SENSORS_ENABLED

            config SHT40_I2C_ADDR
                hex "SHT40 I2C Address"
                default 0x44

            config BMP388_I2C_ADDR
                hex "BMP388 I2C Address"
                default 0x77

            config SCD41_I2C_ADDR
                hex "SCD41 I2C Address"
                default 0x62

            config ENS160_I2C_ADDR
                hex "ENS160 I2C Address"
                default 0x53

            config SGP40_I2C_ADDR
                hex "SGP40 I2C Address"
                default 0x59

            config BH1750_I2C_ADDR
                hex "BH1750 I2C Address"
                default 0x23
        endmenu

        menu "UART1 - mmWave Radar (LD2410)"
            depends on OMNI_P4_SENSORS_ENABLED

            config LD2410_UART_PORT
                int "UART Port Number"
                default 1
                range 1 2

            config LD2410_UART_TX_GPIO
                int "UART TX GPIO"
                default 43
                range 0 54

            config LD2410_UART_RX_GPIO
                int "UART RX GPIO"
                default 44
                range 0 54

            config LD2410_UART_BAUD
                int "UART Baud Rate"
                default 256000
        endmenu

        menu "UART2 - Voice Recognition (SEN0540)"
            depends on OMNI_P4_SENSORS_ENABLED

            config SEN0540_UART_PORT
                int "UART Port Number"
                default 2
                range 1 2

            config SEN0540_UART_TX_GPIO
                int "UART TX GPIO"
                default 45
                range 0 54

            config SEN0540_UART_RX_GPIO
                int "UART RX GPIO"
                default 46
                range 0 54

            config SEN0540_UART_BAUD
                int "UART Baud Rate"
                default 9600
        endmenu

        config SENSOR_READ_INTERVAL_MS
            int "Sensor Read Interval (ms)"
            default 5000
            range 1000 60000
            depends on OMNI_P4_SENSORS_ENABLED
    endmenu

    menu "Network Configuration"
        config WIFI_SSID
            string "WiFi SSID"
            default "your_ssid"
            help
                SSID of the WiFi network to connect to.

        config WIFI_PASSWORD
            string "WiFi Password"
            default "your_password"
            help
                Password for the WiFi network.

        config MQTT_BROKER_URI
            string "MQTT Broker URI"
            default "mqtt://homeassistant.local:1883"
            help
                URI of the MQTT broker for Home Assistant integration.

        config MQTT_TOPIC_PREFIX
            string "MQTT Topic Prefix"
            default "omni_p4"
            help
                Prefix for all MQTT topics.
    endmenu

endmenu
```

## sdkconfig.defaults
```kconfig
# ============================================================================
# Omni-P4 SDK Configuration Defaults
# Target: ESP32-P4-Function-EV-Board
# ESP-IDF: v5.3+
# ============================================================================

# --- Target Selection ---
CONFIG_IDF_TARGET="esp32p4"

# --- CPU & Memory ---
CONFIG_ESP_DEFAULT_CPU_FREQ_MHZ_400=y
CONFIG_ESP_DEFAULT_CPU_FREQ_MHZ=400
CONFIG_SPIRAM=y
CONFIG_SPIRAM_MODE_OCT=y
CONFIG_SPIRAM_SPEED_200M=y
CONFIG_SPIRAM_BOOT_INIT=y
CONFIG_SPIRAM_USE_MALLOC=y
CONFIG_SPIRAM_MALLOC_ALWAYSINTERNAL=4096
CONFIG_SPIRAM_MALLOC_RESERVE_INTERNAL=65536

# --- Flash Configuration ---
CONFIG_ESPTOOLPY_FLASHMODE_QIO=y
CONFIG_ESPTOOLPY_FLASHFREQ_80M=y
CONFIG_ESPTOOLPY_FLASHSIZE_16MB=y
CONFIG_PARTITION_TABLE_CUSTOM=y
CONFIG_PARTITION_TABLE_CUSTOM_FILENAME="partitions.csv"

# --- FreeRTOS ---
CONFIG_FREERTOS_HZ=1000
CONFIG_FREERTOS_USE_TICKLESS_IDLE=n
CONFIG_FREERTOS_TIMER_TASK_STACK_DEPTH=4096
CONFIG_FREERTOS_IDLE_TASK_STACKSIZE=2048

# --- Heap Configuration ---
CONFIG_HEAP_POISONING_COMPREHENSIVE=n
CONFIG_HEAP_TRACING_OFF=y

# --- Logging ---
CONFIG_LOG_DEFAULT_LEVEL_INFO=y
CONFIG_LOG_MAXIMUM_LEVEL_DEBUG=y

# --- I2S Audio Configuration ---
CONFIG_SOC_I2S_NUM=2
CONFIG_SOC_I2S_SUPPORTS_TDM=y

# --- I2C Configuration ---
CONFIG_I2C_ENABLE_SLAVE=n

# --- UART Configuration ---
CONFIG_UART_ISR_IN_IRAM=y

# --- RMT (LED Strip) ---
CONFIG_RMT_ISR_IRAM_SAFE=y

# --- MIPI-DSI Display ---
CONFIG_LCD_RGB_ISR_IRAM_SAFE=y

# --- LVGL Configuration ---
CONFIG_LV_USE_PERF_MONITOR=y
CONFIG_LV_USE_MEM_MONITOR=y
CONFIG_LV_MEM_CUSTOM=y
CONFIG_LV_COLOR_DEPTH_16=y
CONFIG_LV_DPI_DEF=130
CONFIG_LV_FONT_MONTSERRAT_14=y
CONFIG_LV_FONT_MONTSERRAT_20=y
CONFIG_LV_FONT_MONTSERRAT_24=y
CONFIG_LV_USE_THEME_DEFAULT=y

# --- WiFi ---
CONFIG_ESP_WIFI_ENABLED=y
CONFIG_ESP_WIFI_STATIC_RX_BUFFER_NUM=16
CONFIG_ESP_WIFI_DYNAMIC_RX_BUFFER_NUM=32
CONFIG_ESP_WIFI_CACHE_TX_BUFFER_NUM=32
CONFIG_ESP_WIFI_TX_BUFFER_TYPE=1
CONFIG_ESP_WIFI_DYNAMIC_TX_BUFFER_NUM=32
CONFIG_ESP_WIFI_AMPDU_TX_ENABLED=y
CONFIG_ESP_WIFI_AMPDU_RX_ENABLED=y

# --- Ethernet (EV Board has Ethernet PHY) ---
CONFIG_ETH_USE_ESP32_EMAC=y
CONFIG_ETH_PHY_INTERFACE_RMII=y

# --- Power Management ---
CONFIG_PM_ENABLE=y
CONFIG_PM_DFS_INIT_AUTO=y

# --- Task Watchdog ---
CONFIG_ESP_TASK_WDT_EN=y
CONFIG_ESP_TASK_WDT_TIMEOUT_S=10
CONFIG_ESP_TASK_WDT_CHECK_IDLE_TASK_CPU0=y

# --- Compiler Optimization ---
CONFIG_COMPILER_OPTIMIZATION_PERF=y

# --- Application Components ---
CONFIG_OMNI_P4_AUDIO_ENABLED=y
CONFIG_OMNI_P4_DISPLAY_ENABLED=y
CONFIG_OMNI_P4_SENSORS_ENABLED=y
CONFIG_OMNI_P4_LED_ENABLED=y
```
